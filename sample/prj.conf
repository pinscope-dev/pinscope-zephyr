## CMakeLists.txt
```
cmake_minimum_required(VERSION 3.20.0)
# The Pinscope module is two folders up; west builds take it from here.
list(APPEND ZEPHYR_EXTRA_MODULES ${CMAKE_CURRENT_SOURCE_DIR}/..)
find_package(Zephyr REQUIRED HINTS $ENV{ZEPHYR_BASE})
project(pinscope_sample)
target_sources(app PRIVATE src/main.c)
```

## Kconfig
```
mainmenu "Pinscope sample"

# The key and the WiFi network can come from the environment, so the sample
# builds without editing a file:
#   PINSCOPE_KEY=psk_... WIFI_SSID=... WIFI_PASSWORD=... west build -b <board> sample
# (only when the build directory is created; afterwards use west build -t menuconfig).

config PINSCOPE_PROJECT_KEY
	default "$(PINSCOPE_KEY)"

config SAMPLE_WIFI_SSID
	string "WiFi network"
	default "$(WIFI_SSID)"
	depends on WIFI

config SAMPLE_WIFI_PSK
	string "WiFi password"
	default "$(WIFI_PASSWORD)"
	depends on WIFI

source "Kconfig.zephyr"
```

## Kconfig.sysbuild
```
source "share/sysbuild/Kconfig"

# On the nRF5340 the application core has no random generator of its own; it
# asks the Bluetooth controller on the network core, which this image runs.
config NET_CORE_BOARD
	string
	default "nrf7002dk/nrf5340/cpunet" if $(BOARD) = "nrf7002dk"
	default "nrf5340dk/nrf5340/cpunet" if $(BOARD) = "nrf5340dk"

config NET_CORE_IMAGE_HCI_IPC
	bool "HCI IPC image on network core"
	default y
	depends on NET_CORE_BOARD != ""
```

## sysbuild.conf
```
# MCUboot in front of the application, so updates can be tried and rolled back.
SB_CONFIG_BOOTLOADER_MCUBOOT=y
# ECDSA P-256 keeps MCUboot inside the 32 KB the Nucleo boards give it (RSA does not fit).
SB_CONFIG_BOOT_SIGNATURE_TYPE_ECDSA_P256=y
```

## prj.conf
```kconfig
# Pinscope: these two lines. The module switches on the networking, sockets,
# DHCP and settings it uses, and starts itself at boot.
CONFIG_PINSCOPE=y
# The key from the dashboard: here, or PINSCOPE_KEY=psk_... in the environment
# when the build directory is created (see Kconfig).
#CONFIG_PINSCOPE_PROJECT_KEY="psk_..."

# The rest is this sample's own: a web page to reach, and logs worth reading.
CONFIG_MAIN_STACK_SIZE=4096
CONFIG_HEAP_MEM_POOL_SIZE=16384
CONFIG_LOG=y
CONFIG_LOG_DEFAULT_LEVEL=2
CONFIG_LOG_PRINTK=y
```

## wifi-nrf70.conf
```kconfig
# WiFi through an nRF70 (nRF7002 DK, or the nRF7002 EK shield):
#   -Dsample_EXTRA_CONF_FILE=wifi-nrf70.conf
CONFIG_WIFI=y
CONFIG_NET_L2_WIFI_MGMT=y
CONFIG_WIFI_NM_WPA_SUPPLICANT=y
CONFIG_HEAP_MEM_POOL_SIZE=80000
CONFIG_NET_PKT_RX_COUNT=8
CONFIG_NET_PKT_TX_COUNT=8
CONFIG_NET_BUF_RX_COUNT=16
CONFIG_NET_BUF_TX_COUNT=16
```

## boards/disco_l475_iot1.conf
```kconfig
# B-L475E-IOT01A: WiFi through its Inventek ISM43362 module, which runs the
# TCP/IP stack itself (offloaded sockets), so Zephyr's own buffers stay small:
# the STM32L475 has 128 KB of RAM.
CONFIG_WIFI=y
CONFIG_WIFI_ESWIFI=y
CONFIG_NET_L2_WIFI_MGMT=y
CONFIG_NET_PKT_RX_COUNT=4
CONFIG_NET_PKT_TX_COUNT=4
CONFIG_NET_BUF_RX_COUNT=8
CONFIG_NET_BUF_TX_COUNT=8
# The eswifi driver asks for 50 KB of heap; Pinscope's connection, the stream
# to the page and DNS need far less, so the heap is set by hand.
CONFIG_HEAP_MEM_POOL_IGNORE_MIN=y
CONFIG_HEAP_MEM_POOL_SIZE=32768
```

## boards/esp32c3_devkitm.conf
```kconfig
# ESP32-C3-DevKitM under Zephyr: WiFi (the driver's binary libraries come with
# `west blobs fetch hal_espressif`).
CONFIG_WIFI=y
CONFIG_NET_L2_WIFI_MGMT=y
CONFIG_HEAP_MEM_POOL_SIZE=65536
```

## boards/esp32c6_devkitc_hpcore.conf
```kconfig
# ESP32-C6 (DevKitC-1 and boards with the same chip) under Zephyr: WiFi
# (the driver's binary libraries come with `west blobs fetch hal_espressif`).
CONFIG_WIFI=y
CONFIG_NET_L2_WIFI_MGMT=y
CONFIG_HEAP_MEM_POOL_SIZE=65536
```

## boards/esp32s3_devkitc_procpu.conf
```kconfig
# ESP32-S3-DevKitC under Zephyr: WiFi (the driver's binary libraries come with
# `west blobs fetch hal_espressif`).
CONFIG_WIFI=y
CONFIG_NET_L2_WIFI_MGMT=y
CONFIG_HEAP_MEM_POOL_SIZE=65536
# Crash reports with the call chain (Zephyr's Xtensa unwinder).
CONFIG_XTENSA_ENABLE_BACKTRACE=y
```

## slot1-external-flash.overlay
```dts
/* nRF5340 DK or nRF7002 DK with WiFi: the WiFi stack does not leave room for
 * two images in the 1 MB of internal flash: the application gets all of it, and the update slot goes to the
 * board's external flash (MX25R64). MCUboot uses the same layout. */
/delete-node/ &slot1_partition;

&slot0_partition {
	reg = <0x00010000 0xe8000>;
};

&mx25r64 {
	partitions {
		compatible = "fixed-partitions";
		#address-cells = <1>;
		#size-cells = <1>;

		slot1_partition: partition@0 {
			label = "image-1";
			reg = <0x00000000 0xe8000>;
		};
	};
};
```

## boards/mps2_an385.overlay
```dts
/* Keep the simulated flash in RAM that a reset does not reload, so
 * settings (device token, id) survive a reboot as they do on real flash. */
&sram0 {
	reg = <0x20000000 0x3f8000>;
};
/ {
	simflash_ram: memory@203f8000 {
		compatible = "zephyr,memory-region", "mmio-sram";
		reg = <0x203f8000 0x8000>;
		zephyr,memory-region = "SIMFLASH";
	};
};
&sim_flash_controller {
	memory-region = <&simflash_ram>;
};
```

## boards/nrf7002dk_nrf5340_cpuapp.overlay
```dts
/* The WiFi stack does not leave room for two images in the 1 MB of internal
 * flash: the application gets all of it, and the update slot goes to the
 * board's external flash (MX25R64). MCUboot uses the same layout. */
/delete-node/ &slot1_partition;

&slot0_partition {
	reg = <0x00010000 0xe8000>;
};

&mx25r64 {
	partitions {
		compatible = "fixed-partitions";
		#address-cells = <1>;
		#size-cells = <1>;

		slot1_partition: partition@0 {
			label = "image-1";
			reg = <0x00000000 0xe8000>;
		};
	};
};
```

## boards/nucleo_f429zi.overlay
```dts
/* Settings need a storage partition; the board leaves its slot commented out.
 * Two 16 KB sectors between MCUboot and the first image slot. */
&flash0 {
	partitions {
		storage_partition: partition@8000 {
			compatible = "zephyr,mapped-partition";
			label = "storage";
			reg = <0x00008000 DT_SIZE_K(32)>;
		};
	};
};
```

## boards/rpi_pico2_rp2350a_m33_0_w.overlay
```dts
/* Settings take the last 64 KB of the 4 MB flash. */
&flash0 {
	partitions {
		storage_partition: partition@3f0000 {
			compatible = "zephyr,mapped-partition";
			label = "storage";
			reg = <0x003f0000 DT_SIZE_K(64)>;
		};
	};
};
```

## boards/w55rp20_evb_pico.overlay
```dts
/* Zephyr's own W55RP20-EVB-Pico board, without MCUboot (no updates): the
 * application starts the flash, settings take its last 64 KB. With MCUboot,
 * build for w55rp20_pinscope instead. */
&code_partition {
	reg = <0x100 (DT_SIZE_M(2) - 0x100 - DT_SIZE_K(64))>;
};

&flash0 {
	partitions {
		storage_partition: partition@1f0000 {
			compatible = "zephyr,mapped-partition";
			label = "storage";
			reg = <0x001f0000 DT_SIZE_K(64)>;
		};
	};
};
```

## src/main.c
```c
/*
 * Pinscope on Zephyr: a small web page on port 80, reachable through the
 * device's Pinscope address, plus metrics and logs.
 */
#include <stdio.h>
#include <string.h>

#include <zephyr/kernel.h>
#include <zephyr/net/net_if.h>
#include <zephyr/net/net_mgmt.h>
#include <zephyr/net/net_ip.h>
#include <netinet/in.h>
#include <sys/socket.h>
#include <unistd.h>
#ifdef CONFIG_WIFI
#include <zephyr/net/wifi_mgmt.h>
#endif
#ifdef CONFIG_BT
#include <zephyr/bluetooth/bluetooth.h>
#endif

#if defined(CONFIG_BOARD_W55RP20_PINSCOPE) || defined(CONFIG_BOARD_W55RP20_EVB_PICO)
#include <zephyr/drivers/hwinfo.h>
#include <zephyr/net/ethernet.h>
#include <zephyr/net/ethernet_mgmt.h>
#endif

#include "pinscope.h"

#if defined(CONFIG_BOARD_W55RP20_PINSCOPE) || defined(CONFIG_BOARD_W55RP20_EVB_PICO)
/* Every board ships with the same MAC address (00:00:00:01:02:03); make one
 * from the flash chip's ID, locally administered, so two boards can share a LAN. */
static void unique_mac(void)
{
    uint8_t id[8] = { 0 };
    struct ethernet_req_params params = { 0 };
    hwinfo_get_device_id(id, sizeof(id));
    params.mac_address.addr[0] = 0x02;
    memcpy(&params.mac_address.addr[1], &id[3], 5);
    struct net_if *iface = net_if_get_default();
    net_if_down(iface);
    net_mgmt(NET_REQUEST_ETHERNET_SET_MAC_ADDRESS, iface, &params, sizeof(params));
    net_if_up(iface);
}
#endif

/* The address and Pinscope's state, whenever they change: for bring-up. */
static void report(void *a, void *b, void *c)
{
    static const char *states[] = { "stopped", "connecting", "online", "rejected" };
    char last[96] = "";
    ARG_UNUSED(a);
    ARG_UNUSED(b);
    ARG_UNUSED(c);
    for (;;) {
        char ip[NET_IPV4_ADDR_LEN] = "none", now[96];
        struct net_if *iface = net_if_get_default();
        struct in_addr *addr = iface ? net_if_ipv4_get_global_addr(iface, NET_ADDR_PREFERRED) : NULL;
        if (addr) {
            net_addr_ntop(AF_INET, addr, ip, sizeof(ip));
        }
        snprintf(now, sizeof(now), "link %s, ip %s, pinscope %s", iface && net_if_is_up(iface) ? "up" : "down", ip,
                 states[pinscope_state()]);
        if (strcmp(now, last)) {
            printk("status: %s %s\n", now, pinscope_url());
            strcpy(last, now);
        }
        k_sleep(K_SECONDS(1));
    }
}
K_THREAD_DEFINE(report_thread, 1024, report, NULL, NULL, NULL, 10, 0, 1000);

static void serve(void)
{
    int server = socket(AF_INET, SOCK_STREAM, IPPROTO_TCP);
    struct sockaddr_in addr = { .sin_family = AF_INET, .sin_port = htons(80) };
    int one = 1;
    setsockopt(server, SOL_SOCKET, SO_REUSEADDR, &one, sizeof(one));
    if (bind(server, (struct sockaddr *)&addr, sizeof(addr)) != 0 || listen(server, 2) != 0) {
        printk("cannot listen on port 80\n");
        return;
    }
    for (;;) {
        int client = accept(server, NULL, NULL);
        if (client < 0) {
            continue;
        }
        char request[1024], page[256];
        /* Read the whole request: closing with unread bytes resets the
         * connection, and the reply would be lost. */
        size_t got = 0;
        while (got < sizeof(request) - 1) {
            int n = (int)recv(client, request + got, sizeof(request) - 1 - got, 0);
            if (n <= 0) {
                break;
            }
            got += (size_t)n;
            request[got] = '\0';
            if (strstr(request, "\r\n\r\n")) {
                break;
            }
        }
        /* For testing crash reports: a NULL write, like a real bug. */
        if (!strncmp(request, "GET /crash ", 11)) {
            printk("crashing on purpose\n");
            k_msleep(500); /* time for the line to reach the server */
            *(volatile uint32_t *)0 = 0xdead;
        }
        int body = snprintf(page, sizeof(page),
                            "<!doctype html><title>%s</title><h1>Hello from %s</h1><p>Up for %lld s.</p>",
                            CONFIG_BOARD, CONFIG_BOARD, k_uptime_get() / 1000);
        char head[128];
        int n = snprintf(head, sizeof(head),
                         "HTTP/1.1 200 OK\r\nContent-Type: text/html\r\nContent-Length: %d\r\nConnection: close\r\n\r\n", body);
        send(client, head, n, 0);
        send(client, page, body, 0);
        close(client);
    }
}

int main(void)
{
#ifdef CONFIG_BT
    bt_enable(NULL); /* the random generator for the keys is behind it */
#endif
#if defined(CONFIG_BOARD_W55RP20_PINSCOPE) || defined(CONFIG_BOARD_W55RP20_EVB_PICO)
    unique_mac();
#endif
#ifdef CONFIG_WIFI
    struct wifi_connect_req_params wifi = {
        .ssid = (const uint8_t *)CONFIG_SAMPLE_WIFI_SSID,
        .ssid_length = sizeof(CONFIG_SAMPLE_WIFI_SSID) - 1,
        .psk = (const uint8_t *)CONFIG_SAMPLE_WIFI_PSK,
        .psk_length = sizeof(CONFIG_SAMPLE_WIFI_PSK) - 1,
        .security = WIFI_SECURITY_TYPE_PSK,
        .channel = WIFI_CHANNEL_ANY,
        .band = WIFI_FREQ_BAND_2_4_GHZ,
    };
    net_mgmt(NET_REQUEST_WIFI_CONNECT, net_if_get_default(), &wifi, sizeof(wifi));
#endif
    serve();
    return 0;
}
```
